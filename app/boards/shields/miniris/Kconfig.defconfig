## app/boards/shields/miniris/Kconfig.defconfig
```kconfig
if SHIELD_MINIRIS_LEFT

config ZMK_KEYBOARD_NAME
    default "Miniris"

config ZMK_SPLIT_ROLE_CENTRAL
    default y

endif

if SHIELD_MINIRIS_LEFT || SHIELD_MINIRIS_RIGHT

config ZMK_SPLIT
    default y

endif
```

## app/boards/shields/miniris/Kconfig.shield
```kconfig
config SHIELD_MINIRIS_LEFT
    def_bool $(shields_list_contains,miniris_left)

config SHIELD_MINIRIS_RIGHT
    def_bool $(shields_list_contains,miniris_right)
```
